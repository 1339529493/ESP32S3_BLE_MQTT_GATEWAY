## sdkconfig.defaults
```kconfig
#
# Target Configuration
#
CONFIG_IDF_TARGET="esp32s3"

#
# Wi-Fi Configuration
#
CONFIG_ESP_WIFI_ENABLED=y
CONFIG_ESP_WIFI_DYNAMIC_TX_BUFFER=y
CONFIG_ESP_WIFI_DYNAMIC_TX_BUFFER_NUM=32
CONFIG_ESP_WIFI_STATIC_RX_BUFFER_NUM=10
CONFIG_ESP_WIFI_DYNAMIC_RX_BUFFER_NUM=32
CONFIG_ESP_WIFI_SW_COEXIST_ENABLE=y

#
# Bluetooth Configuration
#
CONFIG_BT_ENABLED=y
CONFIG_BT_BLE_ENABLED=y
CONFIG_BT_GATTS_ENABLE=y
CONFIG_BT_GATTC_ENABLE=y
CONFIG_BT_NIMBLE_ENABLED=y
CONFIG_BT_CTRL_SCAN_DUPL=y
CONFIG_BT_CTRL_DFT_TX_POWER_LEVEL_P9=y
CONFIG_SW_COEXIST_ENABLE=y

#
# SPIRAM (PSRAM) Configuration
#
CONFIG_SPIRAM=y
CONFIG_SPIRAM_MODE_OCT=y
CONFIG_SPIRAM_SPEED_80M=y
CONFIG_SPIRAM_USE_MALLOC=y
CONFIG_SPIRAM_MALLOC_ALWAYSINTERNAL=16384
CONFIG_SPIRAM_BOOT_INIT=y
CONFIG_SPIRAM_MEMTEST=y

#
# LVGL Configuration
#
CONFIG_LV_CONF_SKIP=y
# 注意：通常建议将 lv_conf.h 放在项目根目录并设置 CONFIG_LV_CONF_SKIP=y
# 如果你希望通过 Kconfig 直接配置 LVGL，请移除上面一行并启用以下常用项：
# CONFIG_LV_COLOR_DEPTH_16=y
# CONFIG_LV_MEM_SIZE_KILOBYTES=64
# CONFIG_LV_USE_FLEX=y
# CONFIG_LV_USE_GRID=y

#
# Log Level
#
CONFIG_LOG_DEFAULT_LEVEL_INFO=y
CONFIG_LOG_DEFAULT_LEVEL=3

#
# Compiler Optimization
#
CONFIG_OPTIMIZATION_LEVEL_DEBUG=y
CONFIG_COMPILER_OPTIMIZATION_LEVEL_DEBUG=y

#
# Partition Table
# 确保你的分区表支持 OTA 或足够大的 app 空间，这里仅保留基础配置
# 如果需要特定分区表，请在 menuconfig 中设置 CONFIG_PARTITION_TABLE_CUSTOM
#

#
# Brownout Detector
#
CONFIG_BROWNOUT_DET_LVL=7
CONFIG_ESP_SYSTEM_BROWNOUT_INTR=y

#
# Timekeeping
#
CONFIG_NEWLIB_TIME_SYSCALL_USE_RTC_HRT=y
CONFIG_ESP32S3_TIME_SYSCALL_USE_RTC_SYSTIMER=y
```
